#include "corne_miryoku.dtsi"

CONFIG_ZMK_POINTING=y

&kscan0 {
        row-gpios
                = <&pro_micro 18 (GPIO_ACTIVE_HIGH | GPIO_PULL_DOWN)>
                , <&pro_micro 19 (GPIO_ACTIVE_HIGH | GPIO_PULL_DOWN)>
                , <&pro_micro 15 (GPIO_ACTIVE_HIGH | GPIO_PULL_DOWN)>
                , <&pro_micro 14 (GPIO_ACTIVE_HIGH | GPIO_PULL_DOWN)>
                ;

        col-gpios
                = <&pro_micro 2 GPIO_ACTIVE_HIGH>
                , <&pro_micro 3 GPIO_ACTIVE_HIGH>
                , <&pro_micro 4 GPIO_ACTIVE_HIGH>
                , <&pro_micro 5 GPIO_ACTIVE_HIGH>
                , <&pro_micro 6 GPIO_ACTIVE_HIGH>
                , <&pro_micro 7 GPIO_ACTIVE_HIGH>
                ;
};
