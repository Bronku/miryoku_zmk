#include "corne_miryoku.dtsi"

&kscan0 {
        col-gpios
                = <&pro_micro 14 GPIO_ACTIVE_HIGH>
                , <&pro_micro 15 GPIO_ACTIVE_HIGH>
                , <&pro_micro 18 GPIO_ACTIVE_HIGH>
                , <&pro_micro 19 GPIO_ACTIVE_HIGH>
                , <&pro_micro 20 GPIO_ACTIVE_HIGH>
                , <&pro_micro 21 GPIO_ACTIVE_HIGH>
                ;

        
        row-gpios
                = <&pro_micro 5 (GPIO_ACTIVE_HIGH | GPIO_PULL_DOWN)>
                , <&pro_micro 4 (GPIO_ACTIVE_HIGH | GPIO_PULL_DOWN)>
                , <&pro_micro 6 (GPIO_ACTIVE_HIGH | GPIO_PULL_DOWN)>
                , <&pro_micro 7 (GPIO_ACTIVE_HIGH | GPIO_PULL_DOWN)>
                ;
};
